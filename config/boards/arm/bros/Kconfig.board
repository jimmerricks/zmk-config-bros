## config/boards/arm/bros/Kconfig.board
```kconfig
# Bros board configuration

# Copyright (c) 2022 Bluebell Keyboards
# SPDX-License-Identifier: MIT

config BOARD_BROS
	bool "Bros"
	depends on SOC_STM32F411XE
```

## config/boards/arm/bros/Kconfig.defconfig
```kconfig
# STeMCell board configuration

# Copyright (c) 2022 Bluebell Keyboards
# SPDX-License-Identifier: MIT

if BOARD_BROS

config BOARD
	default "bros"

config ZMK_KEYBOARD_NAME
	default "Bros"

config ZMK_USB
	default y

config SERIAL
	default y

config ZMK_KSCAN_MATRIX_POLLING
	default y

config UART_ASYNC_API
	default y

config BUILD_OUTPUT_UF2_USE_FLASH_BASE
	default y

config BUILD_OUTPUT_UF2_USE_FLASH_OFFSET
	default y

endif # BOARD_BROS
```

## config/boards/arm/bros/bros_defconfig
```kconfig
# SPDX-License-Identifier: MIT
# Copyright (c) 2022 Bluebell Keyboards

CONFIG_SOC_SERIES_STM32F4X=y
CONFIG_SOC_STM32F401XC=y

# MPU Settings
CONFIG_ARM_MPU=y

# enable pin controller
CONFIG_PINCTRL=y

# enable GPIO
CONFIG_GPIO=y

# Code partition
CONFIG_USE_DT_CODE_PARTITION=y

# clock configuration
CONFIG_CLOCK_CONTROL=y

# disable polling for both direct and matrix
CONFIG_ZMK_KSCAN_MATRIX_POLLING=y
CONFIG_ZMK_KSCAN_DIRECT_POLLING=y

# build a UF2 image
CONFIG_BUILD_OUTPUT_UF2=y
CONFIG_BUILD_OUTPUT_UF2_FAMILY_ID="0x57755a57"

# fix for the matrix scan
CONFIG_ZMK_KSCAN_MATRIX_WAIT_BETWEEN_OUTPUTS=1
```
